/*********************************************************************************************************
* 模块名称：Gui.c
* 摘    要：图形界面与页面状态机模块实现（骨架）
* 当前版本：1.0.0
* 作    者：成员A（系统架构与交互层）
* 完成日期：2026年08月
* 内    容：三页面切换、按键事件分发、各页面显示刷新
* 注    意：本文件为骨架，成员A需补全各页面的OLED绘制与按键逻辑
**********************************************************************************************************
* 取代版本：
* 作    者：
* 完成日期：
* 修改内容：
* 修改文件：
*********************************************************************************************************/

/*********************************************************************************************************
*                                              包含头文件
*********************************************************************************************************/
#include "Gui.h"
#include "stm32f10x_conf.h"
#include "OLED.h"
#include "System.h"
#include "DAC.h"
#include "PWM.h"
#include "Flash.h"
#include "Measure.h"

/*********************************************************************************************************
*                                              宏定义
*********************************************************************************************************/

/*********************************************************************************************************
*                                              内部变量
*********************************************************************************************************/

/*********************************************************************************************************
*                                              枚举结构体定义
*********************************************************************************************************/

/*********************************************************************************************************
*                                              内部函数声明
*********************************************************************************************************/
static void  Gui_ShowOutputPage(void);     //显示信号输出页
static void  Gui_ShowMeasurePage(void);    //显示信号测量页
static void  Gui_ShowSettingPage(void);    //显示参数设置页
static void  Gui_HandleOutputKey(u8 keyId, u8 evt);   //输出页按键处理
static void  Gui_HandleMeasureKey(u8 keyId, u8 evt);  //测量页按键处理
static void  Gui_HandleSettingKey(u8 keyId, u8 evt);  //设置页按键处理

/*********************************************************************************************************
*                                              内部函数实现
*********************************************************************************************************/
/*********************************************************************************************************
* 函数名称：Gui_ShowOutputPage
* 函数功能：显示信号输出页（输出类型、参数值、启停状态）
* 输入参数：void
* 输出参数：void
* 返 回 值：void
* 创建日期：2026年08月
* 注    意：TODO(成员A) 补全OLED绘制
*********************************************************************************************************/
static void  Gui_ShowOutputPage(void)
{
  //TODO(成员A): 显示当前outputMode/dacDcLevel/pwmFreqIndex/pwmDutyIndex/outputEnable
}

/*********************************************************************************************************
* 函数名称：Gui_ShowMeasurePage
* 函数功能：显示信号测量页（ADC波形或频率测量结果）
* 输入参数：void
* 输出参数：void
* 返 回 值：void
* 创建日期：2026年08月
* 注    意：调用Measure_DisplayWave或Measure_ShowFreqResult
*********************************************************************************************************/
static void  Gui_ShowMeasurePage(void)
{
  //TODO(成员A): 根据measureMode显示ADC波形或频率结果
  if(g_systemState.measureMode == MEASURE_MODE_ADC)
  {
    Measure_DisplayWave();
  }
  else
  {
    Measure_ShowFreqResult();
  }
}

/*********************************************************************************************************
* 函数名称：Gui_ShowSettingPage
* 函数功能：显示参数设置页（参数列表、当前选中项、档位）
* 输入参数：void
* 输出参数：void
* 返 回 值：void
* 创建日期：2026年08月
* 注    意：
*********************************************************************************************************/
static void  Gui_ShowSettingPage(void)
{
  //TODO(成员A): 显示参数列表，高亮paramIndex选中项
}

/*********************************************************************************************************
* 函数名称：Gui_HandleOutputKey
* 函数功能：信号输出页按键处理
* 输入参数：keyId - 按键编号; evt - 事件类型
* 输出参数：void
* 返 回 值：void
* 创建日期：2026年08月
* 注    意：KEY2短按启动输出，KEY3短按停止输出
*********************************************************************************************************/
static void  Gui_HandleOutputKey(u8 keyId, u8 evt)
{
  //TODO(成员A): 实现启停逻辑
  (void)keyId;
  (void)evt;
}

/*********************************************************************************************************
* 函数名称：Gui_HandleMeasureKey
* 函数功能：信号测量页按键处理
* 输入参数：keyId - 按键编号; evt - 事件类型
* 输出参数：void
* 返 回 值：void
* 创建日期：2026年08月
* 注    意：可切换ADC/频率测量模式
*********************************************************************************************************/
static void  Gui_HandleMeasureKey(u8 keyId, u8 evt)
{
  //TODO(成员A): 实现测量模式切换
  (void)keyId;
  (void)evt;
}

/*********************************************************************************************************
* 函数名称：Gui_HandleSettingKey
* 函数功能：参数设置页按键处理
* 输入参数：keyId - 按键编号; evt - 事件类型
* 输出参数：void
* 返 回 值：void
* 创建日期：2026年08月
* 注    意：KEY2增/KEY3减/KEY4长按2s保存返回
*********************************************************************************************************/
static void  Gui_HandleSettingKey(u8 keyId, u8 evt)
{
  //TODO(成员A): 实现参数选择/增减/长按保存
  if(keyId == KEY_ID_KEY4 && evt == KEY_EVENT_LONG_PRESS)
  {
    Flash_SaveParams(&g_systemState);   //保存参数
    Gui_SwitchPage(PAGE_OUTPUT);        //返回主页面
  }
  (void)keyId;
  (void)evt;
}

/*********************************************************************************************************
*                                              API函数实现
*********************************************************************************************************/
/*********************************************************************************************************
* 函数名称：InitGui
* 函数功能：初始化GUI模块，显示首页
* 输入参数：void
* 输出参数：void
* 返 回 值：void
* 创建日期：2026年08月
* 注    意：
*********************************************************************************************************/
void  InitGui(void)
{
  //TODO(成员A): 初始化OLED，显示输出页
  OLEDClear();
  Gui_ShowOutputPage();
}

/*********************************************************************************************************
* 函数名称：Gui_ProcessKeyEvent
* 函数功能：处理按键事件，根据当前页面分发
* 输入参数：keyId - 按键编号; evt - 事件类型
* 输出参数：void
* 返 回 值：void
* 创建日期：2026年08月
* 注    意：KEY1短按循环切换页面
*********************************************************************************************************/
void  Gui_ProcessKeyEvent(u8 keyId, u8 evt)
{
  //KEY1短按：循环切换页面
  if(keyId == KEY_ID_KEY1 && evt == KEY_EVENT_SHORT_PRESS)
  {
    g_systemState.page = (g_systemState.page + 1) % 3;
    OLEDClear();
    return;
  }

  //按当前页面分发按键
  switch(g_systemState.page)
  {
    case PAGE_OUTPUT:  Gui_HandleOutputKey(keyId, evt);  break;
    case PAGE_MEASURE: Gui_HandleMeasureKey(keyId, evt); break;
    case PAGE_SETTING: Gui_HandleSettingKey(keyId, evt); break;
    default: break;
  }
}

/*********************************************************************************************************
* 函数名称：Gui_Refresh
* 函数功能：刷新当前页面显示（周期调用，≥10Hz）
* 输入参数：void
* 输出参数：void
* 返 回 值：void
* 创建日期：2026年08月
* 注    意：
*********************************************************************************************************/
void  Gui_Refresh(void)
{
  switch(g_systemState.page)
  {
    case PAGE_OUTPUT:  Gui_ShowOutputPage();  break;
    case PAGE_MEASURE: Gui_ShowMeasurePage(); break;
    case PAGE_SETTING: Gui_ShowSettingPage(); break;
    default: break;
  }
}

/*********************************************************************************************************
* 函数名称：Gui_SwitchPage
* 函数功能：切换到指定页面
* 输入参数：page - 目标页面
* 输出参数：void
* 返 回 值：void
* 创建日期：2026年08月
* 注    意：
*********************************************************************************************************/
void  Gui_SwitchPage(u8 page)
{
  g_systemState.page = page;
  OLEDClear();
}

/*********************************************************************************************************
* 函数名称：Gui_GetCurrentPage
* 函数功能：获取当前页面
* 输入参数：void
* 输出参数：void
* 返 回 值：当前页面编号
* 创建日期：2026年08月
* 注    意：
*********************************************************************************************************/
u8  Gui_GetCurrentPage(void)
{
  return g_systemState.page;
}
